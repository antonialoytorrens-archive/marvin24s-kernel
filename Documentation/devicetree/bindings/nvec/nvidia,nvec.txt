## Documentation/devicetree/bindings/nvec/nvidia,nvec.txt
```
NVIDIA compliant embedded controller

The NVIDIA compliant embedded controller (short nvec) is a software API
which can be used to contol several functions of a multi-function-device (mfd).
Often this protocol is implemented in the firmware of an embedded controller,
where devices like keyboards or mice are attached to. Up to now, only early Tegra2
boards make use of this API.

Required properties:
- compatible : should be "nvidia,nvec".
- reg : the iomem of the i2c slave controller
- interrupts : the interrupt line of the i2c slave controller
- clock-frequency : the frequency of the i2c bus
- gpios : the gpio used for ec request
- slave-addr: the i2c address of the slave controller

Optional properties:
- nvidia,nvec-uses-kbd : enables support for a keyboard
                  -mouse : enables support for a ps2 mice
                  -power : enables support for a power adapter (battery and/or ac)
                  -events : enables support for receiving event send by the nvec

- nvidia,nvec-uses-oem = "board-name" : enables support for a board specific
	driver named "nvec-<board-name>". This can be used to add functions not
	provdided by the standard protocol.

- cells : can be used to add parameters to the mfd cells. Each child is named after
  the coresponding cell name:

	- events : This property configures which events to listen to and which events
	  should submitted to userspace upon receive. It add the following properties:
	  - linux,input-type (required) : specifies the linux specific event number
					    (e.g. EV_SW=5, EV_KEY=1)
	  - linux,code (required) : specifies the linux specific key code to submit
	  - nvec,event-status-mask (required) : specifies the nvec event to react on
						(bitmask with length 32)
	  - nvec,event-status (optional) : if set to "enabled", it activates the event
						on boot.
```

## Documentation/devicetree/bindings/power/power_seq.txt
```
Runtime Interpreted Power Sequences
===================================

Power sequences are sequential descriptions of actions to be performed on
power-related resources. Having these descriptions in a well-defined data format
allows us to take much of the board- or device- specific power control code out
of the kernel and place it into the device tree instead, making kernels less
board-dependant.

A device typically makes use of multiple power sequences, for different purposes
such as powering on and off. All the power sequences of a given device are
grouped into a set. In the device tree, this set is a sub-node of the device
node named "power-sequences".

Power Sequences Structure
-------------------------
Every device that makes use of power sequences must have a "power-sequences"
node into which individual power sequences are declared as sub-nodes. The name
of the node becomes the name of the sequence within the power sequences
framework.

Similarly, each power sequence declares its steps as sub-nodes of itself. Steps
must be named sequentially, with the first step named step0, the second step1,
etc. Failure to follow this rule will result in a parsing error.

Power Sequences Steps
---------------------
Steps of a sequence describe an action to be performed on a resource. They
always include a "type" property which indicates what kind of resource this
step works on. Depending on the resource type, additional properties are defined
to control the action to be performed.

"delay" type required properties:
  - delay: delay to wait (in microseconds)

"regulator" type required properties:
  - id: name of the regulator to use.
  - enable / disable: one of these two empty properties must be present to
                      enable or disable the resource

"pwm" type required properties:
  - id: name of the PWM to use.
  - enable / disable: one of these two empty properties must be present to
                      enable or disable the resource

"gpio" type required properties:
  - gpio: phandle of the GPIO to use.
  - value: value this GPIO should take. Must be 0 or 1.

Example
-------
Here are example sequences declared within a backlight device that use all the
supported resources types:

	backlight {
		compatible = "pwm-backlight";
		...

		/* resources used by the power sequences */
		pwms = <&pwm 2 5000000>;
		pwm-names = "backlight";
		power-supply = <&backlight_reg>;

		power-sequences {
			power-on {
				step0 {
					type = "regulator";
					id = "power";
					enable;
				};
				step1 {
					type = "delay";
					delay = <10000>;
				};
				step2 {
					type = "pwm";
					id = "backlight";
					enable;
				};
				step3 {
					type = "gpio";
					gpio = <&gpio 28 0>;
					value = <1>;
				};
			};

			power-off {
				step0 {
					type = "gpio";
					gpio = <&gpio 28 0>;
					value = <0>;
				};
				step1 {
					type = "pwm";
					id = "backlight";
					disable;
				};
				step2 {
					type = "delay";
					delay = <10000>;
				};
				step3 {
					type = "regulator";
					id = "power";
					disable;
				};
			};
		};
	};

The first part lists the PWM and regulator resources used by the sequences.
These resources will be requested on behalf of the backlight device when the
sequences are built and are declared according to their own bindings (for
instance, regulators and pwms are resolved by name - note though that name
declaration is done differently by the two frameworks).

After the resources declaration, two sequences follow for powering the backlight
on and off. Their names are specified by the pwm-backlight device bindings. Once
the sequences are built by calling devm_of_parse_power_seq_set() on the
backlight device, they can be added to a set using
power_seq_set_add_sequences().
```

## Documentation/devicetree/bindings/video/backlight/pwm-backlight.txt
```
pwm-backlight bindings

Required properties:
  - compatible: "pwm-backlight"
  - pwms: OF device-tree PWM specification (see PWM binding[0])
  - brightness-levels: Array of distinct brightness levels. Typically these
      are in the range from 0 to 255, but any range starting at 0 will do.
      The actual brightness level (PWM duty cycle) will be interpolated
      from these values. 0 means a 0% duty cycle (darkest/off), while the
      last value in the array represents a 100% duty cycle (brightest).
  - default-brightness-level: the default brightness level (index into the
      array defined by the "brightness-levels" property)

Optional properties:
  - pwm-names: a list of names for the PWM devices specified in the
      "pwms" property (see PWM binding[0]).
  - power-sequences: Power sequences (see Power sequences[1]) used to bring the
      backlight on and off. If this property is present, then two power
      sequences named "power-on" and "power-off" must be defined to control how
      the backlight is to be powered on and off. These sequences must reference
      the PWM specified in the pwms property by its name, and can also reference
      other resources supported by the power sequences mechanism

[0]: Documentation/devicetree/bindings/pwm/pwm.txt
[1]: Documentation/devicetree/bindings/power/power_seq.txt

Example:

	backlight {
		compatible = "pwm-backlight";
		brightness-levels = <0 4 8 16 32 64 128 255>;
		default-brightness-level = <6>;
		low-threshold-brightness = <50>;

		/* resources used by the power sequences */
		pwms = <&pwm 0 5000000>;
		pwm-names = "backlight";
		power-supply = <&backlight_reg>;

		power-sequences {
			power-on {
				step0 {
					type = "regulator";
					id = "power";
					enable;
				};
				step1 {
					type = "delay";
					delay = <10000>;
				};
				step2 {
					type = "pwm";
					id = "backlight";
					enable;
				};
				step3 {
					type = "gpio";
					gpio = <&gpio 28 0>;
					value = <1>;
				};
			};

			power-off {
				step0 {
					type = "gpio";
					gpio = <&gpio 28 0>;
					value = <0>;
				};
				step1 {
					type = "pwm";
					id = "backlight";
					disable;
				};
				step2 {
					type = "delay";
					delay = <10000>;
				};
				step3 {
					type = "regulator";
					id = "power";
					disable;
				};
			};
		};
	};
```

## Documentation/devicetree/bindings/video/display/chunghwa,claa101wa01a.txt
```
Chunghwa CLAA101WA01A Display Panel

Required properties:
- compatible: "chunghwa,claa101wa01a"
- pnl-supply: regulator controlling power supply to the panel
- bl-supply: regulator controlling power supply to the backlight
- pnl-enable-gpios: GPIO that enables the panel
- bl-enable-gpios: GPIO that enables the backlight
```
